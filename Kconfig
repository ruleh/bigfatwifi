## Kconfig
```kconfig
#
# For a description of the syntax of this configuration file,
# see Documentation/kbuild/kconfig-language.txt.
#
mainmenu "Linux/$ARCH $KERNELVERSION Kernel Configuration"

source "drivers/zzbigfatmod/Kconfig"
config SRCARCH
	string
	option env="SRCARCH"

source "arch/$SRCARCH/Kconfig"
```

## drivers/zzbigfatmod/Kconfig
```kconfig
menu "The bigfat module"

source "drivers/zzbigfatmod/wireless/Kconfig"
source "drivers/zzbigfatmod/mac80211/Kconfig"
source "drivers/zzbigfatmod/misc/Kconfig"
source "drivers/zzbigfatmod/drivers/wireless/Kconfig"

endmenu
```

## drivers/zzbigfatmod/drivers/wireless/Kconfig
```kconfig
#
# Wireless LAN device configuration
#

menuconfig WLAN
	bool "Wireless LAN"
	depends on !S390
	depends on NET
	select WIRELESS
	default y
	---help---
	  This section contains all the pre 802.11 and 802.11 wireless
	  device drivers. For a complete list of drivers and documentation
	  on them refer to the wireless wiki:

	  http://wireless.kernel.org/en/users/Drivers

	  Note: Only a few drivers are included as of yet ;)

if WLAN

source "drivers/zzbigfatmod/drivers/wireless/ath/Kconfig"
source "drivers/zzbigfatmod/drivers/wireless/iwlwifi/Kconfig"
source "drivers/zzbigfatmod/drivers/wireless/iwlegacy/Kconfig"
source "drivers/zzbigfatmod/drivers/wireless/rt2x00/Kconfig"
source "drivers/zzbigfatmod/drivers/wireless/rtl818x/Kconfig"


config MAC80211_HWSIM
	tristate "Simulated radio testing tool for mac80211"
	depends on MAC80211
	---help---
	  This driver is a developer testing tool that can be used to test
	  IEEE 802.11 networking stack (mac80211) functionality. This is not
	  needed for normal wireless LAN usage and is only for testing. See
	  Documentation/networking/mac80211_hwsim for more information on how
	  to use this tool.

	  To compile this driver as a module, choose M here: the module will be
	  called mac80211_hwsim.  If unsure, say N.


config WIFI_CONTROL_FUNC
	bool "Enable WiFi control function abstraction"
	help
	  Enables Power/Reset/Carddetect function abstraction


endif # WLAN
```

## drivers/zzbigfatmod/misc/Kconfig
```kconfig
config CRC_ITU_ST
	bool "enable crc-itu-t error check (required by rt73usb)"
	---help---
 	This is some eror-checking module that is being included
	in the bigfatwifi module because it is needed by the rt73usb driver.
	However if this module is already included in your kernel
	you don't need and should not compile this as part of the bigfatwifi module.

	This will NOT be auto-selected anymore. You need to do this yourself.

	If unsure say Y
config EEPROM_93
	bool "enable eeprom for certain devices (required by rtl8187L)"
	---help---
	I have really no idea why this is needed but the module won't load
	without it if you have included rtl8187. 
	Anyways, it is better to inlcude it than not to.

	This will NOT be auto-selected. You need to do this yourself.

	If unsure say Y
config 3_15_COMPAT
	bool "enable enhanced compatibility"
	---help---
	This should improve compatibility on higher kernel versions by
	not relying on external symbols anymore but instead having them 
	defined inside the module.

	WARNING:This increases the size and might not work (actually it doesn't right now)

	Turn this off. Select N. This does not work.
```
